## xingshan/fbb_ws63-jiuyuanduan/fbb_ws63-master/src/application/samples/products/sle_relay/Kconfig
```kconfig
#===============================================================================
# @brief    SLE static relay sample Kconfig
#===============================================================================

choice
    prompt "Select SLE relay board role"
    default SAMPLE_SUPPORT_SLE_RELAY_NODE
    depends on SAMPLE_SUPPORT_SLE_RELAY

    config SAMPLE_SUPPORT_SLE_RELAY_ROOT
        bool "Root server board"

    config SAMPLE_SUPPORT_SLE_RELAY_NODE
        bool "Relay board"

    config SAMPLE_SUPPORT_SLE_RELAY_LEAF
        bool "Leaf terminal board"

    config SAMPLE_SUPPORT_SLE_RELAY_MESH
        bool "Self-organizing mesh board"
endchoice

config SLE_RELAY_UART_BUS
    int
    prompt "Set UART bus used by optional local bridge."
    default 0
    depends on SAMPLE_SUPPORT_SLE_RELAY

config SUPPORT_SLE_PERIPHERAL
    bool
    default y if (SAMPLE_SUPPORT_SLE_RELAY_ROOT || SAMPLE_SUPPORT_SLE_RELAY_NODE || SAMPLE_SUPPORT_SLE_RELAY_MESH)

config SUPPORT_SLE_CENTRAL
    bool
    default y if (SAMPLE_SUPPORT_SLE_RELAY_NODE || SAMPLE_SUPPORT_SLE_RELAY_LEAF || SAMPLE_SUPPORT_SLE_RELAY_MESH)
```

## xingshan/fbb_ws63-shouzaiduan/fbb_ws63-master/src/application/samples/products/sle_relay/Kconfig
```kconfig
#===============================================================================
# @brief    SLE static relay sample Kconfig
#===============================================================================

choice
    prompt "Select SLE relay board role"
    default SAMPLE_SUPPORT_SLE_RELAY_NODE
    depends on SAMPLE_SUPPORT_SLE_RELAY

    config SAMPLE_SUPPORT_SLE_RELAY_ROOT
        bool "Root server board"

    config SAMPLE_SUPPORT_SLE_RELAY_NODE
        bool "Sky relay board"

    config SAMPLE_SUPPORT_SLE_RELAY_VICTIM
        bool "Victim terminal board"

    config SAMPLE_SUPPORT_SLE_RELAY_LEAF
        bool "Leaf terminal board"

    config SAMPLE_SUPPORT_SLE_RELAY_MESH
        bool "Self-organizing mesh board"
endchoice

config SLE_RELAY_VICTIM_INDEX
    int "Victim terminal index"
    range 1 3
    default 1
    depends on SAMPLE_SUPPORT_SLE_RELAY_VICTIM

config SLE_RELAY_UART_BUS
    int
    prompt "Set UART bus used by optional local bridge."
    default 0
    depends on SAMPLE_SUPPORT_SLE_RELAY

config SUPPORT_SLE_PERIPHERAL
    bool
    default y if (SAMPLE_SUPPORT_SLE_RELAY_ROOT || SAMPLE_SUPPORT_SLE_RELAY_NODE || SAMPLE_SUPPORT_SLE_RELAY_VICTIM || SAMPLE_SUPPORT_SLE_RELAY_MESH)

config SUPPORT_SLE_CENTRAL
    bool
    default y if (SAMPLE_SUPPORT_SLE_RELAY_NODE || SAMPLE_SUPPORT_SLE_RELAY_VICTIM || SAMPLE_SUPPORT_SLE_RELAY_LEAF || SAMPLE_SUPPORT_SLE_RELAY_MESH)
```
